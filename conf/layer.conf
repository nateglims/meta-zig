## conf/layer.conf
```bitbake
# We have a conf and classes directory, add to BBPATH
BBPATH .= ":${LAYERDIR}"

# We have recipes-* directories, add to BBFILES
BBFILES += "${LAYERDIR}/recipes-*/*/*.bb \
            ${LAYERDIR}/recipes-*/*/*.bbappend"

BBFILE_COLLECTIONS += "meta-zig"
BBFILE_PATTERN_meta-zig = "^${LAYERDIR}/"
BBFILE_PRIORITY_meta-zig = "6"

LAYERDEPENDS_meta-zig = "core clang-layer"
LAYERSERIES_COMPAT_meta-zig = "mickledore"
```
